## meta/conf/distro/include/yocto-uninative.inc
```bitbake
#
# This include points at uninative tarballs generated and maintained
# by the Yocto Project. These file can be included by distros if they
# want to use/maintain a unified sstate feed for native/cross artefacts
# rather than the feeds having native/cross artefacts which are specific
# to the distro running on the build machine.
#

UNINATIVE_MAXGLIBCVERSION = "2.37"
#UNINATIVE_VERSION = "3.9"
UNINATIVE_VERSION = "3.9.gcc-13-2023-05-26"

UNINATIVE_URL = "file:///OE/build/uninative/${UNINATIVE_VERSION}/"
#UNINATIVE_URL ?= "http://downloads.yoctoproject.org/releases/uninative/${UNINATIVE_VERSION}/"
UNINATIVE_CHECKSUM[aarch64] ?= "cc881b6a09e46099ec7e375bca614bc7a182ea1684c4ada38a386510d05409ea"
UNINATIVE_CHECKSUM[i686] ?= "25824700bdc7c19fda3234436c4f8efe92e623babb32810c59442b57e2900bc1"
UNINATIVE_CHECKSUM[x86_64] ?= "87e0b301173fa295bfca9aa70a02b75ce3941ee6a3c4a0011f1a6c2a65c5da5d"
```

## meta/conf/machine/qemuarm64-multilib.conf
```bitbake
#@TYPE: Machine
#@NAME: QEMU ARMv8 machine
#@DESCRIPTION: Machine configuration for running an ARMv8 system on QEMU

require qemuarm64.conf

MACHINEOVERRIDES .= ":qemuarm64"
KMACHINE = "qemuarm64"

require conf/multilib.conf
MULTILIBS = "multilib:lib32"
DEFAULTTUNE:virtclass-multilib-lib32 = "armv7at-neon"

LIB32_PREFIX = "lib32-"

# Set 64-bit libs path to lib instead of lib64
# and 32-bit libs path to lib32 instead of lib
# It will have more advantages to use /lib, /lib32 instead of /lib, /lib64 in webOS platform
BASELIB = "lib32"
BASE_LIB:tune-aarch64 = "lib"
BASE_LIB:tune-aarch64_be = "lib"
BASE_LIB:tune-aarch64_le = "lib"
```

## meta/conf/machine/qemuppc64.conf
```bitbake
#@TYPE: Machine
#@NAME: QEMU PPC64 machine
#@DESCRIPTION: Machine configuration for running a PPC system on QEMU

require conf/machine/include/qemu.inc
require conf/machine/include/tune-power9.inc

#TARGET_CC_KERNEL_ARCH = "-mno-spe"

KERNEL_IMAGETYPE = "vmlinux"

SERIAL_CONSOLES ?= "115200;ttyS0 115200;hvc0"

# For runqemu
QB_SYSTEM_NAME = "qemu-system-ppc64"
QB_MACHINE = "-machine pseries"
QB_CPU = "-cpu POWER9"
QB_KERNEL_CMDLINE_APPEND = "console=tty console=ttyS0"
QB_OPT_APPEND = "-show-cursor"
QB_OPT_APPEND += "-device qemu-xhci -device usb-tablet -device usb-kbd"
# Add the virtio RNG
QB_OPT_APPEND += "-object rng-random,filename=/dev/urandom,id=rng0 -device virtio-rng-pci,rng=rng0"
# Virtio Networking support
QB_TAP_OPT = "-netdev tap,id=net0,ifname=@TAP@,script=no,downscript=no"
# Virtio serial console
QB_SERIAL_OPT = "-device virtio-serial-device -chardev null,id=virtcon -device virtconsole,chardev=virtcon"
QB_TCPSERIAL_OPT = "-device virtio-serial-device -chardev socket,id=virtcon,port=@PORT@,host=127.0.0.1 -device virtconsole,chardev=virtcon"

#prelink broken on ppc64
#USER_CLASSES_remove = "image-prelink"
#IMAGE_PREPROCESS_COMMAND_remove = "prelink_image;"
```

## meta/conf/machine/qemux86-64-multilib.conf
```bitbake
#@TYPE: Machine
#@NAME: QEMU x86-64 machine
#@DESCRIPTION: Machine configuration for running an x86-64 system on QEMU

require qemux86-64.conf

MACHINEOVERRIDES .= ":qemux86-64"

require conf/multilib.conf
MULTILIBS = "multilib:lib32"
DEFAULTTUNE:virtclass-multilib-lib32 = "i586"

LIB32_PREFIX = "lib32-"

# Set 64-bit libs path to lib instead of lib64
# and 32-bit libs path to lib32 instead of lib
# It will have more advantages to use /lib, /lib32 instead of /lib, /lib64 in webOS platform
BASELIB = "lib32"
BASE_LIB:tune-aarch64 = "lib"
BASE_LIB:tune-aarch64_be = "lib"
BASE_LIB:tune-aarch64_le = "lib"
```
